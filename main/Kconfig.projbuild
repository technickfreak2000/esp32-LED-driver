## main/Kconfig.projbuild
```kconfig
menu "Wifi Configuration"

    config ESP_WIFI_SSID
        string "WiFi SSID"
        default "myssid"
        help
            SSID (network name) for the example to connect to.

    config ESP_WIFI_PASSWORD
        string "WiFi Password"
        default "mypassword"
        help
            WiFi password (WPA or WPA2) for the example to use.
    config ESP_WIFI_CHANNEL
        int "WiFi Channel"
        range 1 13
        default 1
        help
            WiFi channel (network channel) for the example to use.

    config ESP_MAX_STA_CONN
        int "Maximal STA connections"
        default 4
        help
            Max number of the STA connects to AP.
endmenu

menu "LED driver Configuration"

    config ESP_LED_PIN
        int "LED PIN"
        range 0 39
        default 4
        help
            Defines which pin to use for led
    config RMT_LED_STRIP_RESOLUTION_HZ
        int "RMT led strip resolution"
        default 10000000
        help
            10MHz resolution, 1 tick = 0.1us (led strip needs a high resolution)
endmenu

menu "SPIFFS Configuration"

    config SPIFFS_BASE_PATH
        string  "DO NOT CHANGE NOT FULLY IMPLEMENTED!!! Base Path"
        default "/data"
        help
            Defines the base path
endmenu

menu "Webserver Configuration"

    config SCRATCH_BUFSIZE
        int  "Max Filesize"
        default 10240

    config MAX_FILE_SIZE
        int  "Max Filesize"
        default 204800
        help
            200*1024 = 200KB; Max size of an individual file in KB. Make sure this value is same as that set in upload_script.html
endmenu
```
